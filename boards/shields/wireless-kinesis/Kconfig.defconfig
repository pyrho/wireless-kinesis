## boards/shields/wireless-kinesis/Kconfig.defconfig
```kconfig
if SHIELD_WIRELESS_KINESIS

config ZMK_KEYBOARD_NAME
    default "Wireless Kinesis"

endif
```

## boards/shields/wireless-kinesis/Kconfig.shield
```kconfig
config SHIELD_WIRELESS_KINESIS
    def_bool $(shields_list_contains,wireless_kinesis)
```
